## src/Config.in
```kconfig
menu "BELArcade"
	source "$BR2_EXTERNAL_BELARCADE_PATH/package/mednafen/Config.in"
	source "$BR2_EXTERNAL_BELARCADE_PATH/package/gamepad-bridge/Config.in"
	source "$BR2_EXTERNAL_BELARCADE_PATH/package/belarcade-frontend/Config.in"
endmenu
```

## src/configs/belarcade_defconfig
```kconfig
# ---------- Base: Raspberry Pi 4 de 64 bits (igual que raspberrypi4_64_defconfig) ----------
BR2_aarch64=y
BR2_cortex_a72=y
BR2_ARM_FPU_VFPV4=y
BR2_PACKAGE_HOST_LINUX_HEADERS_CUSTOM_6_6=y
BR2_TOOLCHAIN_BUILDROOT_GLIBC=y
BR2_TOOLCHAIN_BUILDROOT_CXX=y
BR2_GLOBAL_PATCH_DIR="board/raspberrypi/patches"
BR2_JLEVEL=3
BR2_TARGET_GENERIC_HOSTNAME="belarcade"
BR2_TARGET_GENERIC_ISSUE="BELArcade"
BR2_TARGET_GENERIC_ROOT_PASSWD="belarcade"
BR2_ROOTFS_DEVICE_CREATION_DYNAMIC_EUDEV=y
BR2_SYSTEM_DHCP="eth0"
BR2_ROOTFS_OVERLAY="$(BR2_EXTERNAL_BELARCADE_PATH)/board/belarcade/rootfs-overlay"
BR2_ROOTFS_POST_BUILD_SCRIPT="$(BR2_EXTERNAL_BELARCADE_PATH)/board/belarcade/post-build.sh"
BR2_ROOTFS_POST_IMAGE_SCRIPT="$(BR2_EXTERNAL_BELARCADE_PATH)/board/belarcade/post-image.sh"

# ---------- Kernel de la Raspberry Pi ----------
BR2_LINUX_KERNEL=y
BR2_LINUX_KERNEL_CUSTOM_TARBALL=y
BR2_LINUX_KERNEL_CUSTOM_TARBALL_LOCATION="$(call github,raspberrypi,linux,576cc10e1ed50a9eacffc7a05c796051d7343ea4)/linux-576cc10e1ed50a9eacffc7a05c796051d7343ea4.tar.gz"
BR2_LINUX_KERNEL_DEFCONFIG="bcm2711"
BR2_LINUX_KERNEL_CONFIG_FRAGMENT_FILES="$(BR2_EXTERNAL_BELARCADE_PATH)/board/belarcade/linux_extra.config"
BR2_LINUX_KERNEL_DTS_SUPPORT=y
BR2_LINUX_KERNEL_INTREE_DTS_NAME="broadcom/bcm2711-rpi-4-b"
BR2_LINUX_KERNEL_NEEDS_HOST_OPENSSL=y

# ---------- Firmware y arranque ----------
BR2_PACKAGE_RPI_FIRMWARE=y
BR2_PACKAGE_RPI_FIRMWARE_VARIANT_PI4=y
BR2_PACKAGE_RPI_FIRMWARE_CONFIG_FILE="$(BR2_EXTERNAL_BELARCADE_PATH)/board/belarcade/config_4_64bit.txt"
BR2_PACKAGE_RPI_FIRMWARE_CMDLINE_FILE="$(BR2_EXTERNAL_BELARCADE_PATH)/board/belarcade/cmdline.txt"

# ---------- Graficos: Mesa (GPU de la Pi 4) + SDL2 directo en pantalla (KMS/DRM) ----------
BR2_PACKAGE_MESA3D=y
BR2_PACKAGE_MESA3D_GALLIUM_DRIVER_V3D=y
BR2_PACKAGE_MESA3D_GALLIUM_DRIVER_VC4=y
BR2_PACKAGE_MESA3D_OPENGL_EGL=y
BR2_PACKAGE_MESA3D_OPENGL_ES=y
BR2_PACKAGE_MESA3D_GBM=y
BR2_PACKAGE_SDL2=y
BR2_PACKAGE_SDL2_KMSDRM=y
BR2_PACKAGE_SDL2_OPENGLES=y
BR2_PACKAGE_SDL2_TTF=y

# ---------- Audio, imagen de arranque y utilidades ----------
BR2_PACKAGE_ALSA_LIB=y
BR2_PACKAGE_ALSA_UTILS=y
BR2_PACKAGE_ALSA_UTILS_APLAY=y
BR2_PACKAGE_ALSA_UTILS_AMIXER=y
BR2_PACKAGE_FBV=y
BR2_PACKAGE_FBV_PNG=y
BR2_PACKAGE_PYTHON3=y
BR2_PACKAGE_KMOD=y
BR2_PACKAGE_KMOD_TOOLS=y
BR2_PACKAGE_LINUXCONSOLETOOLS=y
BR2_PACKAGE_LINUXCONSOLETOOLS_JOYSTICK=y
BR2_PACKAGE_DROPBEAR=y
BR2_PACKAGE_XZ=y
BR2_PACKAGE_BUSYBOX_SHOW_OTHERS=y

# ---------- Paquetes propios de BELArcade ----------
BR2_PACKAGE_MEDNAFEN=y
BR2_PACKAGE_GAMEPAD_BRIDGE=y
BR2_PACKAGE_BELARCADE_FRONTEND=y

# ---------- Imagen ----------
BR2_TARGET_ROOTFS_EXT2=y
BR2_TARGET_ROOTFS_EXT2_4=y
BR2_TARGET_ROOTFS_EXT2_SIZE="1G"
# BR2_TARGET_ROOTFS_TAR is not set
BR2_PACKAGE_HOST_DOSFSTOOLS=y
BR2_PACKAGE_HOST_GENIMAGE=y
BR2_PACKAGE_HOST_KMOD_XZ=y
BR2_PACKAGE_HOST_MTOOLS=y
```

## src/package/belarcade-frontend/Config.in
```kconfig
config BR2_PACKAGE_BELARCADE_FRONTEND
	bool "belarcade-frontend"
	depends on BR2_PACKAGE_SDL2
	select BR2_PACKAGE_SDL2_TTF
	help
	  Frontend grafico de BELArcade (galeria de juegos estilo neon).
```

## src/package/gamepad-bridge/Config.in
```kconfig
config BR2_PACKAGE_GAMEPAD_BRIDGE
	bool "gamepad-bridge"
	help
	  Traduce los botones del control (/dev/input/js0) a teclas de un
	  teclado virtual (uinput) para el frontend y Mednafen.
```

## src/package/mednafen/Config.in
```kconfig
config BR2_PACKAGE_MEDNAFEN
	bool "mednafen"
	depends on BR2_INSTALL_LIBSTDCPP
	depends on BR2_TOOLCHAIN_HAS_THREADS
	depends on BR2_PACKAGE_SDL2
	select BR2_PACKAGE_ZLIB
	select BR2_PACKAGE_ALSA_LIB
	select BR2_PACKAGE_FLAC
	help
	  Mednafen: emulador multi-sistema (NES, SNES, GB/GBC, GBA).
	  https://mednafen.github.io/
```
